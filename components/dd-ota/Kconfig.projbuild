## components/dd-ota/Kconfig.projbuild
```kconfig
menu "DogDog OTA"
    config DOGDOG_OTA_ENABLED
        bool "Enable DogDog OTA boot probe"
        default y
        help
            On boot, scan for the dedicated DogDog OTA Wi-Fi. If it is found
            and the device can connect, download a firmware image from the
            configured short OTA relay URL.

    config DOGDOG_OTA_WIFI_SSID
        string "DogDog OTA Wi-Fi SSID"
        depends on DOGDOG_OTA_ENABLED
        default "dogdog-ota"

    config DOGDOG_OTA_WIFI_PASSWORD
        string "DogDog OTA Wi-Fi password"
        depends on DOGDOG_OTA_ENABLED
        default "dogdog-ota"

    config DOGDOG_OTA_BASE_URL
        string "DogDog OTA base URL"
        depends on DOGDOG_OTA_ENABLED
        default "https://ota.dogdog-zeitmessung.de"
        help
            Firmware URLs are built as <base>/firmware/<device>.bin.

    config DOGDOG_OTA_FALLBACK_DEVICE_NAME
        string "Fallback OTA device name"
        depends on DOGDOG_OTA_ENABLED
        default "measure-stations-lora"
        help
            Used only by legacy code paths that still call ota_task without
            passing an explicit device name.

    config DOGDOG_OTA_CONNECT_RETRIES
        int "DogDog OTA Wi-Fi connect retries"
        depends on DOGDOG_OTA_ENABLED
        range 1 20
        default 8

    config DOGDOG_OTA_CONNECT_TIMEOUT_MS
        int "DogDog OTA Wi-Fi connect timeout"
        depends on DOGDOG_OTA_ENABLED
        range 1000 60000
        default 12000

    config DOGDOG_OTA_RECV_TIMEOUT_MS
        int "DogDog OTA receive timeout"
        depends on DOGDOG_OTA_ENABLED
        range 1000 60000
        default 10000

    config DOGDOG_OTA_ENABLE_PARTIAL_HTTP_DOWNLOAD
        bool "Enable partial HTTP download"
        depends on DOGDOG_OTA_ENABLED
        default n
        help
            Disable this by default for OTA images on noisy or weak Wi-Fi links:
            the partial-download path can be much slower because it issues many
            small incremental reads. Enable only when the device has a very
            constrained memory budget and the network is known to be reliable.

    config DOGDOG_OTA_HTTP_REQUEST_SIZE
        int "Partial HTTP request size"
        depends on DOGDOG_OTA_ENABLE_PARTIAL_HTTP_DOWNLOAD
        range 8192 131072
        default 65536
        help
            When partial HTTP downloads are enabled, use a much larger chunk to
            avoid the tiny read loop that causes very low throughput.

    config DOGDOG_OTA_TASK_STACK_SIZE
        int "DogDog OTA worker task stack size"
        depends on DOGDOG_OTA_ENABLED
        range 8192 32768
        default 24576
        help
            HTTPS OTA uses significantly more stack than ESP-IDF's main task.
            The boot probe runs in this temporary task and app_main waits for
            it to finish or reboot.
endmenu
```

## dogdog-controller/main/Kconfig.projbuild
```kconfig
menu "EDIT HERE: Zeitmessanlage configuration"
    config IS_LORA_CONTROLLER
        bool "is_lora_controller"
        default y
        help
            Set to true if this device is a LoRa controller. This value will be
            available in code as CONFIG_IS_LORA_CONTROLLER.
    config SENSOR_AMOUNT
        int "sensor_amount"
        range 0 255
        default 4
        depends on !IS_LORA_CONTROLLER
        help
            Number of sensors connected to the controller. Must be an integer
            between 0 and 255. This value will be available in code as
            CONFIG_SENSOR_AMOUNT.
    config HORN_TIMER_WIFI_CHANNEL
        int "horn_timer_wifi_channel"
        range 1 13
        default 1
        help
            Wi-Fi channel used to broadcast timer elapsed time for the horn.
            This must match CONFIG_BUZZER_SOFTAP_CHANNEL in the horn project.
    config TIMEPANEL_ENABLED
        bool "timepanel_enabled"
        default y
        help
            Send timer, result and parcours commands to the HUB75 timepanel.
    config TIMEPANEL_MAC_ID
        hex "timepanel_mac_id"
        range 0x0000 0xFFFF
        default 0x0002
        help
            Configurable last two bytes of the timepanel MAC. The fixed DogDog
            prefix is de:09:dd:09, so 0x0002 becomes de:09:dd:09:00:02.
    config TIMEPANEL_TEST_TIMER_SEQUENCE
        bool "temporary_timepanel_timer_test_sequence"
        depends on TIMEPANEL_ENABLED
        default n
        help
            Temporary test mode: after boot, send a start trigger into the
            controller timer and then send stop triggers after randomized
            durations. Disable this before real event operation.
    config TIMEPANEL_TEST_TIMER_START_DELAY_MS
        int "temporary_timepanel_timer_test_start_delay_ms"
        depends on TIMEPANEL_TEST_TIMER_SEQUENCE
        range 0 600000
        default 15000
    config TIMEPANEL_TEST_TIMER_REPETITIONS
        int "temporary_timepanel_timer_test_repetitions"
        depends on TIMEPANEL_TEST_TIMER_SEQUENCE
        range 1 100
        default 5
    config TIMEPANEL_TEST_TIMER_GAP_MS
        int "temporary_timepanel_timer_test_gap_ms"
        depends on TIMEPANEL_TEST_TIMER_SEQUENCE
        range 0 600000
        default 7000
    config TIMEPANEL_TEST_TIMER_RUN_MS
        int "temporary_timepanel_timer_test_run_min_ms"
        depends on TIMEPANEL_TEST_TIMER_SEQUENCE
        range 1 600000
        default 20000
    config TIMEPANEL_TEST_TIMER_RUN_MAX_MS
        int "temporary_timepanel_timer_test_run_max_ms"
        depends on TIMEPANEL_TEST_TIMER_SEQUENCE
        range 1 600000
        default 23000
endmenu
```

## horn/main/Kconfig.projbuild
```kconfig
menu "Buzzer Timer"

    config BUZZER_GPIO
        int "Buzzer GPIO"
        default 4
        range 0 33
        help
            GPIO driven high while the buzzer is active.

    config STATUS_LED_GPIO
        int "WS2812B status LED GPIO"
        default 48
        range 0 48
        help
            GPIO connected to the dev board WS2812B data input.

    config BUZZER_DELAY_MS
        int "Default buzzer delay in milliseconds"
        default 30000
        range 0 3600000
        help
            Default delay from the remote timer start to the buzzer sound.
            The web interface can change this at runtime until the next reboot.

    config BUZZER_DURATION_MS
        int "Buzzer duration in milliseconds"
        default 500
        range 1 60000
        help
            How long the buzzer output stays high once it starts buzzing.

    config BUZZER_SOFTAP_SSID
        string "SoftAP SSID"
        default "buzzer-timer"
        help
            Wi-Fi network name created by the ESP32.

    config BUZZER_SOFTAP_PASSWORD
        string "SoftAP password"
        default "buzzer123"
        help
            Wi-Fi password for the ESP32 access point. Use at least 8
            characters. Leave empty for an open network.

    config BUZZER_SOFTAP_CHANNEL
        int "SoftAP and promiscuous channel"
        default 1
        range 1 13
        help
            Wi-Fi channel used by both the ESP32 access point and the
            promiscuous receiver.

endmenu
```

## measure-stations-lora/main/Kconfig.projbuild
```kconfig
menu "EDIT HERE: Zeitmessanlage configuration"
    config NUM_SENSORS_REQUIRED_FOR_TRIGGER
        int "Default sensors required for trigger"
        range 1 10
        default 2
        help
            Fallback used when num_s_req has not yet been provisioned in NVS.
            The stored NVS value is authoritative at runtime.
    config NUM_FAKE_SENSORS
        int "Default XLR virtual sensor count"
        range 1 64
        default 5
        help
            Fallback used when num_fake_s has not yet been provisioned in NVS.
            The stored NVS value is authoritative at runtime.
endmenu
```

## remote/main/Kconfig.projbuild
```kconfig
menu "Horn stop remote"

    config HORN_TIMER_WIFI_CHANNEL
        int "Horn Wi-Fi channel"
        range 1 13
        default 1
        help
            Wi-Fi channel used to send the stop command to the horn.
            This must match CONFIG_BUZZER_SOFTAP_CHANNEL in the horn project.

endmenu
```

## timepanel-hub75/main/Kconfig.projbuild
```kconfig
menu "Timepanel HUB75 configuration"

config TIMEPANEL_PANEL_WIDTH
    int "Single HUB75 panel width"
    range 16 512
    default 64

config TIMEPANEL_PANEL_HEIGHT
    int "Single HUB75 panel height"
    range 16 256
    default 32

config TIMEPANEL_MATRIX_CHAIN_WIDTH
    int "HUB75 panels chained horizontally"
    range 1 8
    default 4

config TIMEPANEL_MATRIX_CHAIN_HEIGHT
    int "HUB75 panels chained vertically"
    range 1 4
    default 1

config TIMEPANEL_PANEL_BRIGHTNESS
    int "HUB75 panel brightness"
    range 0 255
    default 50
    help
        Brightness passed to the HUB75 driver. 0 blanks the panel and 255 is
        maximum brightness.

config TIMEPANEL_HUB75_DOUBLE_BUFFER
    bool "Enable HUB75 DMA double buffering"
    default n
    help
        Allocates a second HUB75 DMA framebuffer. This is smoother, but a
        four-panel ESP32-S3 chain needs a large contiguous DMA-capable SRAM
        block. Keep disabled if HUB75 startup fails while allocating buffer B
        or descriptor chain 1.

config TIMEPANEL_BUTTON_GPIO
    int "Preview mode switch GPIO"
    range 0 48
    default 0

config TIMEPANEL_PARCOURS_SECONDS
    int "Parcours walk timer duration in seconds"
    range 1 3600
    default 420

config TIMEPANEL_PARCOURS_INTRO_SECONDS
    int "Parcours intro duration in seconds"
    range 0 120
    default 5

config TIMEPANEL_IDLE_SPLASH_SECONDS
    int "DogDog splash idle timeout in seconds"
    range 0 3600
    default 300
    help
        Shows the DogDog splash screen after this many seconds without a
        button press or controller command. Set to 0 to disable.

config TIMEPANEL_WIFI_CHANNEL
    int "Timepanel promiscuous Wi-Fi channel"
    range 1 13
    default 1
    help
        Wi-Fi channel used by the controller and the timepanel.

config TIMEPANEL_MAC_ID
    hex "timepanel_mac_id"
    range 0x0000 0xFFFF
    default 0x0002
    help
        Configurable last two bytes of the timepanel MAC. The fixed DogDog
        prefix is de:09:dd:09, so 0x0002 becomes de:09:dd:09:00:02.

config TIMEPANEL_SENSOR_ENABLED
    bool "Log FHT40 temperature and humidity"
    default y

config TIMEPANEL_SENSOR_I2C_PORT
    int "FHT40 I2C port"
    depends on TIMEPANEL_SENSOR_ENABLED
    range 0 1
    default 0

config TIMEPANEL_SENSOR_I2C_SDA_GPIO
    int "FHT40 I2C SDA GPIO"
    depends on TIMEPANEL_SENSOR_ENABLED
    range 0 48
    default 35

config TIMEPANEL_SENSOR_I2C_SCL_GPIO
    int "FHT40 I2C SCL GPIO"
    depends on TIMEPANEL_SENSOR_ENABLED
    range 0 48
    default 36

config TIMEPANEL_SENSOR_I2C_FREQUENCY_HZ
    int "FHT40 I2C frequency"
    depends on TIMEPANEL_SENSOR_ENABLED
    range 10000 1000000
    default 400000

config TIMEPANEL_SENSOR_I2C_INTERNAL_PULLUPS
    bool "Enable internal pull-ups on FHT40 I2C pins"
    depends on TIMEPANEL_SENSOR_ENABLED
    default n

config TIMEPANEL_SENSOR_LOG_INTERVAL_SECONDS
    int "FHT40 console log interval in seconds"
    depends on TIMEPANEL_SENSOR_ENABLED
    range 1 3600
    default 10

endmenu
```

## timepanel-hub75/sdkconfig.defaults
```kconfig
# ESP32-S3 HUB75 time panel defaults.
CONFIG_IDF_TARGET="esp32s3"
CONFIG_ESPTOOLPY_FLASHSIZE_16MB=y
CONFIG_ESPTOOLPY_FLASHSIZE="16MB"
CONFIG_PARTITION_TABLE_CUSTOM=y
CONFIG_PARTITION_TABLE_CUSTOM_FILENAME="partitions.csv"
CONFIG_PARTITION_TABLE_FILENAME="partitions.csv"
CONFIG_MBEDTLS_CERTIFICATE_BUNDLE=y
CONFIG_MBEDTLS_CERTIFICATE_BUNDLE_DEFAULT_FULL=y
CONFIG_MBEDTLS_EXTERNAL_MEM_ALLOC=y
CONFIG_MBEDTLS_DYNAMIC_BUFFER=y
CONFIG_DOGDOG_OTA_ENABLED=y
CONFIG_SPIRAM=y
CONFIG_SPIRAM_MODE_OCT=y
CONFIG_SPIRAM_TYPE_AUTO=y
CONFIG_SPIRAM_SPEED_80M=y
CONFIG_SPIRAM_USE_MALLOC=y
CONFIG_SPIRAM_ALLOW_BSS_SEG_EXTERNAL_MEMORY=y
CONFIG_FREERTOS_HZ=1000
CONFIG_COMPILER_OPTIMIZATION_PERF=y
CONFIG_LOG_DEFAULT_LEVEL_INFO=y

CONFIG_TIMEPANEL_PANEL_WIDTH=64
CONFIG_TIMEPANEL_PANEL_HEIGHT=32
CONFIG_TIMEPANEL_MATRIX_CHAIN_WIDTH=4
CONFIG_TIMEPANEL_MATRIX_CHAIN_HEIGHT=1
CONFIG_TIMEPANEL_PANEL_BRIGHTNESS=50
CONFIG_TIMEPANEL_HUB75_DOUBLE_BUFFER=y
CONFIG_TIMEPANEL_BUTTON_GPIO=0
CONFIG_TIMEPANEL_PARCOURS_SECONDS=30
CONFIG_TIMEPANEL_PARCOURS_INTRO_SECONDS=5
CONFIG_TIMEPANEL_IDLE_SPLASH_SECONDS=300
CONFIG_TIMEPANEL_WIFI_CHANNEL=1
CONFIG_TIMEPANEL_MAC_ID=0x0002
CONFIG_TIMEPANEL_SENSOR_ENABLED=y
CONFIG_TIMEPANEL_SENSOR_I2C_PORT=0
CONFIG_TIMEPANEL_SENSOR_I2C_SDA_GPIO=35
CONFIG_TIMEPANEL_SENSOR_I2C_SCL_GPIO=36
CONFIG_TIMEPANEL_SENSOR_I2C_FREQUENCY_HZ=400000
# CONFIG_TIMEPANEL_SENSOR_I2C_INTERNAL_PULLUPS is not set
CONFIG_TIMEPANEL_SENSOR_LOG_INTERVAL_SECONDS=10

CONFIG_LV_COLOR_DEPTH_16=y
CONFIG_LV_USE_CANVAS=y
CONFIG_LV_USE_LABEL=y
CONFIG_LV_FONT_MONTSERRAT_8=y
CONFIG_LV_FONT_MONTSERRAT_10=y
CONFIG_LV_FONT_MONTSERRAT_12=y
CONFIG_LV_FONT_MONTSERRAT_14=y
CONFIG_LV_FONT_MONTSERRAT_16=y
CONFIG_LV_FONT_MONTSERRAT_18=y
CONFIG_LV_FONT_MONTSERRAT_20=y
```
