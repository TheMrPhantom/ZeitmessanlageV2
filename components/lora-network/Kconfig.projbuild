## components/lora-network/Kconfig.projbuild
```kconfig
menu "LORA Configuration"
	config LORA_GPIO_MISO
		int "LORA MISO Pin"
		default 13
	config LORA_GPIO_MOSI
		int "LORA MOSI Pin"
		default 11
	config LORA_GPIO_SCLK
		int "LORA SCLK Pin"
		default 12
	config LORA_GPIO_NSS
		int "LORA NSS Pin"
		default 10
	config LORA_GPIO_RST
		int "LORA RESET Pin"
		default 7
	config LORA_GPIO_BUSY
		int "LORA BUSY Pin"
		default 9
	config LORA_GPIO_TXEN
		int "LORA TXEN Pin"
		default 5
	config LORA_GPIO_RXEN
		int "LORA RXEN Pin"
		default 4
	config LORA_GPIO_DIO1
		int "LORA DIO1 Pin"
		default 6
endmenu

menu "LORA ID Configuration"
    config LORA_STATION_ID
        int "lora_station_id"
        range 0 255
        default 2
        help
            Numeric station id used by LoRa communications. Must be an integer
            between 0 and 255. This value will be available in code as
            CONFIG_LORA_STATION_ID.
    config LORA_CONTROLLER_ID
        int "lora_controller_id"
        range 0 255
        default 1
        help
            Numeric controller id used by LoRa communications. Must be an integer
            between 0 and 255. This value will be available in code as
            CONFIG_LORA_CONTROLLER_ID.
    config START_LORA_ID
        int "start_lora_id"
        range 0 255
        default 2
        help
            Numeric ID for the start LoRa station. Must be an integer between 0 and 255.
    config STOP_LORA_ID
        int "stop_lora_id"
        range 0 255
        default 3
        help
            Numeric ID for the stop LoRa station. Must be an integer between 0 and 255.
endmenu
```

## remote-pc/main/Kconfig.projbuild
```kconfig
menu "EDIT HERE: Zeitmessanlage configuration"
    choice STATION_TYPE
        prompt "What is the station type?"
        default START
        help
            Choose if the compiled code is for the start or the stop station
        config START
            bool "START"
        config STOP
            bool "STOP"
    endchoice
endmenu
```
